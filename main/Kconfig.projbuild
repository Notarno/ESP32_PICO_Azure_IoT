## main/Kconfig.projbuild
```kconfig
menu "Example Configuration"

config WIFI_SSID
    string "WiFi SSID"
	default "myssid"
	help
		SSID (network name) for the example to connect to.

config WIFI_PASSWORD
    string "WiFi Password"
	default "myssid"
	help
		WiFi password (WPA or WPA2) for the example to use.

		Can be left blank if the network has no security set.

config IOTHUB_CONNECTION_STRING
    string "IOT Hub Device Connection String"
	default "HostName=<host_name>;DeviceId=<device_id>;SharedAccessKey=<device_key>"
	help
		String containing Hostname, Device Id & Device Key in the format:
		
		HostName=<host_name>;DeviceId=<device_id>;SharedAccessKey=<device_key>
		HostName=<host_name>;DeviceId=<device_id>;SharedAccessSignature=<device_sas_token>

		You can get this from the iothub-explorer CLI or the Azure Portal

config MESSAGE_INTERVAL_TIME
    int "Time delay in Milliseconds between two consecutive messages"
    default 100
    help
        Set time delay between two consecutive message sent to the cloud

config MESSAGE_COUNT
    int "Total number of messages to be sent to the cloud"
    default 50
    help
        This example will terminate after sending these many
        messages. If the message count is set as 0 then this example
        will send indefinite messages to the cloud.


config USE_SEC_1
	bool
	default n
	prompt "Use Security Version 1"
	help
		Security version 1 used Curve25519 key exchange for establishing
		secure session between device and client during provisioning

config USE_POP
	bool
	depends on USE_SEC_1
	default y
	prompt "Use proof-of-possession"
	help
		Proof-of-possession can be optionally used to prove that the device is indeed
		in possession of the user who is provisioning the device. This proof-of-possession
		is internally used to generate the shared secret through key exchange.

config POP
	string "Proof-of-possession"
	default "abcd1234"
	depends on USE_POP

config RESET_PROVISIONED
	bool
	default n
	prompt "Reset provisioned status of the device"
	help
		This erases the NVS to reset provisioned status of the device on every reboot.
		Provisioned status is determined by the Wi-Fi STA configuration, saved on the NVS.

config AP_RECONN_ATTEMPTS
	int "Maximum AP connection attempts"
	default 5
	help
		Set the maximum connection attempts to perform when connecting to a Wi-Fi AP.

endmenu
```

## sdkconfig.defaults
```kconfig
# newlib for ESP32 and ESP8266 platform
CONFIG_NEWLIB_ENABLE=y
CONFIG_NEWLIB_LIBRARY_LEVEL_NORMAL=y
CONFIG_NEWLIB_NANO_FORMAT=
CONFIG_SSL_USING_MBEDTLS=y
CONFIG_LWIP_IPV6=y

# Override some defaults so BT stack is enabled
CONFIG_BT_ENABLED=y
CONFIG_BTDM_CONTROLLER_MODE_BLE_ONLY=y
CONFIG_BTDM_CONTROLLER_MODE_BR_EDR_ONLY=
CONFIG_BTDM_CONTROLLER_MODE_BTDM=

# Binary is larger than default size
CONFIG_PARTITION_TABLE_CUSTOM=y
CONFIG_PARTITION_TABLE_CUSTOM_FILENAME="partitions.csv"
CONFIG_PARTITION_TABLE_FILENAME="partitions.csv"
```
